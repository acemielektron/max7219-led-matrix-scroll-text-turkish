//Modified for serial input by Acemi Elektronikci
//Original code: https://howtomechatronics.com/tutorials/arduino/8x8-led-matrix-max7219-tutorial-scrolling-text-android-control-via-bluetooth/
/*
      8x8 LED Matrix MAX7219 Scrolling Text Example

   Based on the following library:
   GitHub | riyas-org/max7219  https://github.com/riyas-org/max7219
*/


#include "serial_stdio.h"
#include <MaxMatrix.h>
#include <avr/pgmspace.h>

PROGMEM const unsigned char CH[] = {
  3, 8, B00000000, B00000000, B00000000, B00000000, B00000000, // space
  1, 8, B01011111, B00000000, B00000000, B00000000, B00000000, // !
  3, 8, B00000011, B00000000, B00000011, B00000000, B00000000, // "
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  4, 8, B00001000, B00000100, B00001000, B00000100, B00000000, // ~  
  //extend with turkish chars - starts  at 127
  4, 8, B00111110, B11000001, B01000001, B00100010, B00000000, // Ç
  4, 8, B00111100, B01000011, B01001011, B01111010, B00000000, // Ğ
  3, 8, B01000010, B01111111, B01000010, B00000000, B00000000, // İ
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  4, 8, B00111000, B01000010, B01000010, B01111000, B00000000, // ü  
};  

int DIN = 7;   // DIN pin of MAX7219 module
int CLK = 6;   // CLK pin of MAX7219 module
int CS = 5;    // CS pin of MAX7219 module
int maxInUse = 1;

MaxMatrix m(DIN, CS, CLK, maxInUse);

byte buffer[10];

//char const PROGMEM text[]= "HowToMechatronics.com  "; // Scrolling text
char const PROGMEM text[]= "Türkçe karakterler: ı-İ-ç-Ç-ş-Ş-ğ-Ğ-ö-Ö-ü-Ü ";

#define MAX_MESSAGE 256
volatile int msg_n = 0;
static char message[MAX_MESSAGE];

ISR(USART_RX_vect)
{
  uint8_t ch = UDR0;

  if (msg_n == (MAX_MESSAGE - 1)) return; //last char must be 0
  switch(ch)
  {
    case '\r':
    case '\n':
      message[msg_n] = 0;
      printf("\nMessage to show: %s", message);
      break;
    case '\b': //backspace
    case 127: //DEL
      if (msg_n > 0) 
      {          
        if (message[msg_n] & (1 << 7)) msg_n -= 2; //if unicode
        else msg_n--;
        serial0_putch(ch);  //echo
      }
      break;
    default:
      if (ch < 32) break; //unhandled control char
      message[msg_n] = ch;
      message[msg_n+1]=0;
      msg_n++;
      serial0_putch(ch);  //echo    
  }//switch
}//ISR

void setup() {
  m.init(); // module initialize
  m.setIntensity(15); // dot matix intensity 0-15
  serial0_init(115200);
  UCSR0B |= (1 << RXCIE0); //enable RX interrupt  
  strcpy_P(message, text);
  msg_n = strlen(message);
  printf("\nMessage to show: %s", message);
}

void loop() {  
  printStringWithShift(message, 200); // (text, scrolling speed)
}

// Display=the extracted characters with scrolling
void printCharWithShift(uint8_t c, int shift_speed) {
  if (c < 32) return;
  c -= 32;
  memcpy_P(buffer, CH + 7 * c, 7);
  m.writeSprite(32, 0, buffer);
  m.setColumn(32 + buffer[0], 0);

  for (int i = 0; i < buffer[0] + 1; i++)
  {
    delay(shift_speed);
    m.shiftLeft(false, false);
  }
}

// Extract the characters from the text string
void printStringWithShift(char* s, int shift_speed) {
  while (*s != 0) {
    if (*s & (1 << 7)) //if msb set (negative number) UTF8      
    {
      printExtCharWithShift(s, shift_speed); 
      s++; //extchars are 2 bytes  
    }   
    else printCharWithShift(*s, shift_speed);
    s++;
  }
}

void printExtCharWithShift(uint8_t *s, int shift_speed)
{
      uint8_t ext_char;
      switch(s[0])
      {
        case 0xC3:  
          if (s[1] == 0x87) ext_char = 1; //Ç
          if (s[1] == 0x96) ext_char = 4; //Ö
          if (s[1] == 0x9C) ext_char = 6; //Ü
          if (s[1] == 0xA7) ext_char = 7; //ç          
          if (s[1] == 0xB6) ext_char = 10; //ö          
          if (s[1] == 0xBC) ext_char = 12; //ü
          break;
        case 0xC4:  
          if (s[1] == 0x9E) ext_char = 2; //Ğ
          if (s[1] == 0x9F) ext_char = 8; //ğ          
          if (s[1] == 0xB0) ext_char = 3; //İ
          if (s[1] == 0xB1) ext_char = 9; //ı          
          break;
        case 0xC5: 
          if (s[1] == 0x9E) ext_char = 5; //Ş
          if (s[1] == 0x9F) ext_char = 11; //ş
          break;
        default:
          ext_char = 0;
      }     
      if (ext_char) printCharWithShift(126+ext_char, shift_speed); //32+95-1 = 126
}      
